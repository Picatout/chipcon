/*
* Copyright 2014, Jacques Deschênes
* This file is part of CHIPcon.
*
*     CHIPcon is free software: you can redistribute it and/or modify
*     it under the terms of the GNU General Public License as published by
*     the Free Software Foundation, either version 3 of the License, or
*     (at your option) any later version.
*
*     CHIPcon is distributed in the hope that it will be useful,
*     but WITHOUT ANY WARRANTY; without even the implied warranty of
*     MERCHANTABILITY or FITNESS FOR A PARTICULAR PURPOSE.  See the
*     GNU General Public License for more details.
*
*     You should have received a copy of the GNU General Public License
*     along with CHIPcon.  If not, see <http://www.gnu.org/licenses/>.
*/

/*
 * console.c
 *
 * Created: 2014-09-30 22:31:27
 *  Author: Jacques Deschênes
 */ 

#include "hardware.h"
#include "text.h"
#include "tvout.h"
#include "keypad.h"

// police 4x5 hexadécimale
PROGMEM const uint8_t font_hex_4x6[16*SHEX_HEIGHT]={
	0xe0,0xa0,0xa0,0xa0,0xe0,0x00, //0
	0xc0,0x40,0x40,0x40,0xe0,0x00, //1
	0xe0,0x20,0xe0,0x80,0xe0,0x00, //2
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	0xe0,0x80,0xe0,0x80,0x80,0x00,  //F
	};
	
// police 8x10 hexadécimale	
PROGMEM const uint8_t font_hex_8x10[16*LHEX_HEIGHT]={
	0x7c,0x82,0x86,0x8a,0x92,0xa2,0xc2,0x82,0x7c,0x00, // 0
	0x08,0x18,0x28,0x08,0x08,0x08,0x08,0x08,0x3e,0x00, // 1
	0x38,0x44,0x82,0x04,0x08,0x10,0x20,0x40,0xfe,0x00, // 2
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	0xfe,0x80,0x80,0x80,0xfe,0x80,0x80,0x80,0x80,0x00, // F
	};
	
	
// police 6x8 caractères ASCII	
PROGMEM const uint8_t font_6x8[FONT_SIZE*CHAR_HEIGHT]={
0x00,0x00,0x00,0x00,0x00,0x00,0x00,0x00, // espace
0x20,0x20,0x20,0x20,0x20,0x00,0x20,0x00, // !
0x50,0x50,0x50,0x00,0x00,0x00,0x00,0x00, // "
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0x00,0x70,0xF8,0xF8,0xF8,0x70,0x00,0x00,// 100 rond			
};

uint8_t font=FONT_ASCII;
uint8_t xpos=0, ypos=0;
	
void select_font(uint8_t font_id){
	font=font_id;
}

void new_line(){
	xpos=0;
	switch (font){
	case FONT_SHEX:
		if ((ypos+SHEX_HEIGHT)<=(VRES-SHEX_HEIGHT+1)){
			ypos+=SHEX_HEIGHT;
		}else{
			scroll_up(SHEX_HEIGHT);
		}
		break;
	case FONT_LHEX:
		if ((ypos+LHEX_HEIGHT)<=(VRES-LHEX_HEIGHT+1)){
			ypos+=LHEX_HEIGHT;
		}else{
			scroll_up(LHEX_HEIGHT);
		}
		break;
	case FONT_ASCII:
		if ((ypos+CHAR_HEIGHT)<=(VRES-CHAR_HEIGHT+1)){
			ypos+=CHAR_HEIGHT;
		}else{
			scroll_up(CHAR_HEIGHT);
		}
		break;	
	}//swtich

}

void put_char(uint8_t c){
	switch(font){
	case FONT_SHEX:	
		if (c<16){
			put_sprite(xpos,ypos,SHEX_HEIGHT,&font_hex_4x6[c*SHEX_HEIGHT],FLASH_MEM);
			xpos+=SHEX_WIDTH;
			if (xpos>(HRES-SHEX_WIDTH+1)){
				new_line();
			}
		}
		break;
	case FONT_LHEX:
		if (c<16){
			put_sprite(xpos,ypos,LHEX_HEIGHT,&font_hex_8x10[c*LHEX_HEIGHT],FLASH_MEM);
			xpos+=LHEX_WIDTH;
			if (xpos>(HRES-LHEX_WIDTH+1)){
				new_line();
			}
		}
		break;
	case FONT_ASCII:
		if (c=='\n'){
			new_line();
		}else if ((c>31) && (c<(FONT_SIZE+32))){
			put_sprite(xpos,ypos,CHAR_HEIGHT,&font_6x8[(c-32)*CHAR_HEIGHT],FLASH_MEM);
			xpos+=CHAR_WIDTH;
			if (xpos>(HRES-CHAR_WIDTH+1)){
				new_line();
			}
		}
		break;		
	}
}

void set_cursor(uint8_t x, uint8_t y){
	xpos=x;
	ypos=y;
}

uint16_t get_cursor(){
	return (xpos<<8)+ypos;
}

void print(const unsigned char* str){
	while (*str) put_char(*str++);
}

void prt_pstr(const char *str){
	uint8_t c;
	while ((c=pgm_read_byte(str++))) put_char(c);	
}


void print_int(uint16_t n){
	uint8_t nstr[12];
	uint8_t i=11;

	do {
		nstr[i--]=n%10+'0';
		n/=10;
	}while (n);
	put_char(' ');
	i++;
	while (i<12) put_char(nstr[i++]);
}

void print_hex(uint16_t n,uint8_t width){
	uint8_t hex[4];
	uint8_t i=3,h;
	
	do{
		h=n&0xf;
		if (h<10) hex[i]=h+'0'; else hex[i]=h+'A'-10;
		n>>=4;
		i--;
		width--;
	}while (n);
	put_char(' ');
	while (width){hex[i--]='0'; width--;}
	i++;
	while (i<4) put_char(hex[i++]);
}

void cursor_left(){
	switch(font){
	case FONT_SHEX:
		if (xpos-SHEX_WIDTH>=0) xpos-=SHEX_WIDTH;
		break;
	case FONT_LHEX:
		if (xpos-LHEX_WIDTH>=0) xpos-=LHEX_WIDTH;
		break;
	case FONT_ASCII:
		if (xpos-CHAR_WIDTH>=0) xpos-=CHAR_WIDTH;
		break;	
	}
}

void text_scroller(const uint8_t *text, uint8_t speed){
	uint8_t c,j;

	cls();
	select_font(FONT_ASCII);
	c=pgm_read_byte(text++);
	while (c){
		set_cursor(0,4*CHAR_HEIGHT);
		while (c && c!='\n'){
			put_char(c);
			c=pgm_read_byte(text++);
			if (keypad_break()) {goto break_out;}
		}
		for (j=0;j<CHAR_HEIGHT;j++){
			frame_delay=speed;
			while(frame_delay);
			scroll_up(1);
			if (keypad_break()) {goto break_out;}
		}
		c=pgm_read_byte(text++);
	}//while
	for (c=0;c<4*CHAR_HEIGHT;c++){
		frame_delay=speed;
		while(frame_delay);
		scroll_up(1);
		if (keypad_break()) { break;}
	}//for
break_out:	
	cls();
}
